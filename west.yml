## west.yml
```yaml
manifest:
  self:
    path: framez

  remotes:
    - name: zephyrproject-rtos
      url-base: https://github.com/faxe1008

  defaults:
    remote: zephyrproject-rtos

  projects:
    - name: zephyr
      revision: 958bdc60b2ca1e70d962ab5a41302ed76ab810d6
      import:
        path-prefix: vendor
        path-allowlist:
          - modules/hal/espressif
```
